## package/1-example/example_boost_stacktrace/Config.in
```kconfig
config BR2_PACKAGE_EXAMPLE_BOOST_STACKTRACE
bool "example_boost_stacktrace"
help
  example_boost_stacktrace.
```

## package/1-example/example_libbacktrace/Config.in
```kconfig
config BR2_PACKAGE_EXAMPLE_LIBBACKTRACE
bool "example_libbacktrace"
help
  example_libbacktrace.
```

## package/example_libunwind/Config.in
```kconfig
config BR2_PACKAGE_EXAMPLE_LIBUNWIND
bool "example_libunwind"
help
  example_libunwind.
```
